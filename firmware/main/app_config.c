#include "app_config.h"

#include <string.h>

#include "esp_log.h"
#include "nvs.h"
#include "nvs_flash.h"

// Local, git-ignored secrets header (generated by flash.sh): WiFi creds, gateway
// URI, device token, default user. When present, its #defines win over the
// fallbacks below.
#if defined(__has_include)
#  if __has_include("secrets.h")
#    include "secrets.h"
#  endif
#endif

// First-boot defaults. Provided by secrets.h above, or these fallbacks, then
// changeable later via NVS / the on-device settings UI.
#ifndef CFG_WIFI_SSID
#define CFG_WIFI_SSID ""
#endif
#ifndef CFG_WIFI_PASS
#define CFG_WIFI_PASS ""
#endif
#ifndef CFG_GATEWAY_URI
#define CFG_GATEWAY_URI "ws://192.168.1.117:8770/ws"
#endif
#ifndef CFG_DEVICE_TOKEN
#define CFG_DEVICE_TOKEN "dev"
#endif
#ifndef CFG_USER_ID
#define CFG_USER_ID "invite_butler_001"
#endif

static const char *TAG = "config";
static const char *NS = "claude_esp";

static void load_str(nvs_handle_t h, const char *key, char *dst, size_t dst_sz, const char *def) {
    size_t len = dst_sz;
    if (nvs_get_str(h, key, dst, &len) != ESP_OK) {
        strlcpy(dst, def, dst_sz);
    }
}

void app_config_load(app_config_t *out) {
    memset(out, 0, sizeof(*out));
    nvs_handle_t h;
    esp_err_t err = nvs_open(NS, NVS_READONLY, &h);
    if (err != ESP_OK) {
        // No stored config yet — use compile-time defaults.
        strlcpy(out->wifi_ssid, CFG_WIFI_SSID, sizeof(out->wifi_ssid));
        strlcpy(out->wifi_pass, CFG_WIFI_PASS, sizeof(out->wifi_pass));
        strlcpy(out->gateway_uri, CFG_GATEWAY_URI, sizeof(out->gateway_uri));
        strlcpy(out->device_token, CFG_DEVICE_TOKEN, sizeof(out->device_token));
        strlcpy(out->user_id, CFG_USER_ID, sizeof(out->user_id));
        ESP_LOGW(TAG, "no NVS config; using compile-time defaults");
        return;
    }
    load_str(h, "wifi_ssid", out->wifi_ssid, sizeof(out->wifi_ssid), CFG_WIFI_SSID);
    load_str(h, "wifi_pass", out->wifi_pass, sizeof(out->wifi_pass), CFG_WIFI_PASS);
    load_str(h, "gateway_uri", out->gateway_uri, sizeof(out->gateway_uri), CFG_GATEWAY_URI);
    load_str(h, "device_token", out->device_token, sizeof(out->device_token), CFG_DEVICE_TOKEN);
    load_str(h, "user_id", out->user_id, sizeof(out->user_id), CFG_USER_ID);
    nvs_close(h);
    ESP_LOGI(TAG, "config loaded: ssid=%s gateway=%s user=%s",
             out->wifi_ssid, out->gateway_uri, out->user_id);
}

esp_err_t app_config_save(const app_config_t *cfg) {
    nvs_handle_t h;
    esp_err_t err = nvs_open(NS, NVS_READWRITE, &h);
    if (err != ESP_OK) return err;
    nvs_set_str(h, "wifi_ssid", cfg->wifi_ssid);
    nvs_set_str(h, "wifi_pass", cfg->wifi_pass);
    nvs_set_str(h, "gateway_uri", cfg->gateway_uri);
    nvs_set_str(h, "device_token", cfg->device_token);
    nvs_set_str(h, "user_id", cfg->user_id);
    err = nvs_commit(h);
    nvs_close(h);
    return err;
}
